## boards/shields/kinesis_micro/Kconfig.shield
```kconfig
# Copyright (c) 2020 Pete Johanson
# SPDX-License-Identifier: MIT

config SHIELD_KINESIS_MICRO
    def_bool $(shields_list_contains,kinesis_micro)
```

## boards/shields/kineziz_adv/Kconfig.shield
```kconfig
# Copyright (c) 2026 Oleh Kostiuk
# SPDX-License-Identifier: MIT

config SHIELD_KINEZIZ_ADV
    def_bool $(shields_list_contains,kineziz_adv)
```

## boards/shields/kineziz_black/Kconfig.shield
```kconfig
# Copyright (c) 2026 Oleh Kostiuk
# SPDX-License-Identifier: MIT

config SHIELD_KINEZIZ_BLACK
    def_bool $(shields_list_contains,kineziz_black)
```

## boards/shields/tbkmini/Kconfig.defconfig
```kconfig
if SHIELD_TBKMINI_6COL_LEFT || SHIELD_TBKMINI_5COL_LEFT

config ZMK_KEYBOARD_NAME
    default "TBK Mini"

config ZMK_SPLIT_ROLE_CENTRAL
    default y

endif

if SHIELD_TBKMINI_6COL_LEFT || SHIELD_TBKMINI_6COL_RIGHT || SHIELD_TBKMINI_5COL_LEFT || SHIELD_TBKMINI_5COL_RIGHT

config ZMK_SPLIT
    default y

endif
```

## boards/shields/tbkmini_5col/Kconfig.defconfig
```kconfig
if SHIELD_TBKMINI_5COL_LEFT

config ZMK_KEYBOARD_NAME
    default "TBK Mini 5Col"

config ZMK_SPLIT_ROLE_CENTRAL
    default y

endif

if SHIELD_TBKMINI_5COL_LEFT || SHIELD_TBKMINI_5COL_RIGHT

config ZMK_SPLIT
    default y

endif
```

## boards/shields/tbkmini_5col/Kconfig.shield
```kconfig
# Copyright (c) 2026 Oleh Kostiuk
# SPDX-License-Identifier: MIT

config SHIELD_TBKMINI_5COL_LEFT
    def_bool $(shields_list_contains,tbkmini_5col_left)

config SHIELD_TBKMINI_5COL_RIGHT
    def_bool $(shields_list_contains,tbkmini_5col_right)
```

## boards/shields/tbkmini_6col/Kconfig.defconfig
```kconfig
if SHIELD_TBKMINI_6COL_LEFT

config ZMK_KEYBOARD_NAME
    default "TBK Mini 6Col"

config ZMK_SPLIT_ROLE_CENTRAL
    default y

endif

if SHIELD_TBKMINI_6COL_LEFT || SHIELD_TBKMINI_6COL_RIGHT

config ZMK_SPLIT
    default y

endif
```

## boards/shields/tbkmini_6col/Kconfig.shield
```kconfig
# Copyright (c) 2026 Oleh Kostiuk
# SPDX-License-Identifier: MIT

config SHIELD_TBKMINI_6COL_LEFT
    def_bool $(shields_list_contains,tbkmini_6col_left)

config SHIELD_TBKMINI_6COL_RIGHT
    def_bool $(shields_list_contains,tbkmini_6col_right)
```
